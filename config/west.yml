## config/west.yml
```yaml
manifest:
  remotes:
    - name: moergo-sc
      url-base: https://github.com/moergo-sc
      # Additional modules containing boards/shields/custom code can be listed here as well
      # See https://docs.zephyrproject.org/3.2.0/develop/west/manifest.html#projects
      # lspecial key: alternate repeat / context / antecedent-morph
    - name: ssbb
      url-base: https://github.com/ssbb
  projects:
    - name: zmk
      remote: moergo-sc
      revision: main
      import: app/west.yml
    - name: zmk-antecedent-morph
      remote: ssbb
      revision: v1
  self:
    path: config
```
